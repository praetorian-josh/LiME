## src/Kconfig
```kconfig
menu "LIME"

config LIME_MEM
	tristate "LiME - Linux Memory Extractor"
	default y
	help
	  LiME (Linux Memory Extractor) is a kernel module/driver for acquiring
	  volatile memory (RAM) from Linux and Android devices for forensic
	  analysis.

	  When built as a module (M), LiME can be loaded with parameters:
	    insmod lime.ko path=/path/to/dump format=lime

	  When built-in (Y), or when loaded as module without parameters,
	  LiME exposes a sysfs interface at /sys/kernel/lime/ with the
	  following attributes:
	    - path: Output destination (file path or tcp:port)
	    - format: Output format (raw, lime, padded)
	    - dio: Direct I/O flag (0 or 1)
	    - localhostonly: TCP localhost only (0 or 1)
	    - digest: Hash algorithm (md5, sha1, sha256, etc.)
	    - target_pid: Process to dump (-1=all memory, >0=specific PID)
	    - timeout: Page read timeout in ms (kernel >= 2.6.35)
	    - compress: Enable compression (kernel with ZLIB_DEFLATE)
	    - state: Current acquisition state (read-only)
	    - trigger: Write 1 to start acquisition
	    - reset: Write 1 to reset state to idle

	  Example usage when built-in (full memory dump):
	    echo "/tmp/memory.lime" > /sys/kernel/lime/path
	    echo "lime" > /sys/kernel/lime/format
	    echo -1 > /sys/kernel/lime/target_pid
	    echo 1 > /sys/kernel/lime/trigger

	  Example usage (process-specific dump):
	    echo "/tmp/process.lime" > /sys/kernel/lime/path
	    echo "lime" > /sys/kernel/lime/format
	    echo 1234 > /sys/kernel/lime/target_pid
	    echo 1 > /sys/kernel/lime/trigger

	  To compile as a module, choose M here: the module will be called lime.
	  To compile into the kernel for avoiding version/symbol issues, choose Y.

config LIME_STEALTH
	bool "Use ioctl interface instead of sysfs (stealth mode)"
	depends on LIME_MEM
	default n
	help
	  Enable ioctl-based control interface instead of sysfs.

	  Creates /dev/lwis-sensor-imx461 (disguised as camera sensor driver)
	  that accepts ioctl commands to configure and trigger acquisition.

	  This is stealthier than sysfs as it:
	  - Creates no /sys/kernel/lime/ directory
	  - Uses device name that blends with existing lwis devices
	  - ioctl calls look like normal camera driver operations
	  - No new kernel interfaces to detect

	  Control via ioctl with magic number 0x4C4D4531.
	  Requires userspace tool for configuration.

	  Choose Y for maximum stealth.
	  Choose N for convenient sysfs interface (default).

endmenu
```
